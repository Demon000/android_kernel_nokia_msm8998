/* DRG preEVT SDM636 */

/* MemMap parts */
#include "memmap-evb.dtsi"

/* Common DT Info */
#include "common_info_sdm_v7.dtsi"

/* SYSTEM parts */
#include "system-preEVT-630.dtsi"

/* External LDO control */
#include "fixed-regulator-EVT-v1.dtsi"

/* Keypad parts */
#include "keypad.dtsi"

/* PMIC parts */

/* GPIO parts */

/* Peripheral */

/* Charging */
#include "charger-evt1.dtsi"
#include "drg-setting.dtsi"

/* Audio */

/* Camera */
#include "camera-drg-evt.dtsi"

/* Haptic */
#include "haptics-drg.dtsi"

/* SD */
#include "sd-evb.dtsi"

/* Fingerprint */
#include "fingerprint-gf5288-evt.dtsi"

/* Sensor */
/* NO HALL Sensor */

/* Touch */
/* SW4-HL-TP-BringUpGT915L-00*_20180119 */
#include "touch-gt915l-ctc.dtsi"

/* LCM */
/* SW4-HL-Display-BringUpCTCOTM1911A-00*_20180116 */
#include "dsi-panel-fih-ctc-otm1911a-fhd-video.dtsi"
/* SW4-HL-Display-OTM1911A-AUO-BringUp-00+_20180221 */
#include "dsi-panel-fih-auo-otm1911a-fhd-video.dtsi"